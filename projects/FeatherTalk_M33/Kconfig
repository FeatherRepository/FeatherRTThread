## projects/FeatherTalk_M33/Kconfig
```kconfig
mainmenu "RT-Thread Configuration"

config BSP_DIR
    string
    option env="BSP_ROOT"
    default "."

config RTT_DIR
    string
    option env="RTT_ROOT"
    default "rt-thread"

# you can change the RTT_ROOT default "rt-thread"
# example : default "F:/git_repositories/rt-thread"

config PKGS_DIR
    string
    option env="PKGS_ROOT"
    default "packages"

config ENV_DIR
    string
    option env="ENV_ROOT"
    default "/"

config PLATFORM_DIR
    string
    option env="PLATFORM_DIR"
    default "platform"

source "$RTT_DIR/Kconfig"
source "$PKGS_DIR/Kconfig"
source "$RTT_DIR/../libraries/M33_Config/Kconfig"

menu "FeatherTalk Bluetooth"

choice
    prompt "Bluetooth host stack"
    default FEATHERTALK_BT_STACK_BK
    help
        Exactly one host stack drives the CYW55512 HCI UART (SCB4).
        BK is the open-source product line; AIROC is the precompiled
        Infineon reference kept for comparison and fallback.

config FEATHERTALK_BT_STACK_NONE
    bool "None"

config FEATHERTALK_BT_STACK_BK
    bool "btstack (BlueKitchen, open source)"

config FEATHERTALK_BT_STACK_AIROC
    bool "AIROC (Infineon precompiled, reference)"

endchoice

endmenu
```

## projects/FeatherTalk_M55/Kconfig
```kconfig
mainmenu "RT-Thread Configuration"

config BSP_DIR
    string
    option env="BSP_ROOT"
    default "."

config RTT_DIR
    string
    option env="RTT_ROOT"
    default "rt-thread"

# you can change the RTT_ROOT default "rt-thread"
# example : default "F:/git_repositories/rt-thread"

config PKGS_DIR
    string
    option env="PKGS_ROOT"
    default "packages"

config ENV_DIR
    string
    option env="ENV_ROOT"
    default "/"

config PLATFORM_DIR
    string
    option env="PLATFORM_DIR"
    default "platform"

source "$RTT_DIR/Kconfig"
source "$PKGS_DIR/Kconfig"
source "$RTT_DIR/../libraries/M55_Config/Kconfig"
source "$RTT_DIR/../libraries/components/CherryUSB-1.6.0/Kconfig.rtt"

menu "FeatherTalk Product"

config FEATHERTALK_USING_WIFI
    bool "Enable FeatherTalk asynchronous Wi-Fi service"
    select RT_USING_WIFI_HOST_DRIVER
    select RT_USING_LWIP
    select BSP_USING_FREERTOS
    default y
    help
        Use the SDK CYW55500 WHD port on SDIO0. Select embedded resources,
        never the demo FAL partitions which overlap the product Flash disk.


config FEATHERTALK_USING_GPU_UI
    bool "Enable FeatherUI GPU-native shell"
    depends on BSP_USING_LCD
    default n
    help
        Replace LVGL with the product-owned retained UI runtime. Every frame is
        collected into one immutable display list, encoded into one VG-Lite
        command buffer, submitted once, and presented by swapping two native
        DC8000Nano scanout surfaces. This option is intentionally independent
        from BSP_USING_LVGL.

config FEATHERTALK_USING_UI_SHELL
    bool "Enable FeatherTalk Windows Phone style UI shell"
    depends on BSP_USING_LVGL && !FEATHERTALK_USING_GPU_UI
    default y
    help
        Build the product-owned 480 x 800 shell, bounded page router, and
        application registry instead of starting an upstream LVGL demo.

config FEATHERTALK_USING_LVGL_GPU_BATCH
    bool "Collect each LVGL refresh into a frame-level GPU batch"
    depends on FEATHERTALK_USING_UI_SHELL && BSP_USING_LVGL
    default y
    help
        Keep the full LVGL product widget and interaction model, but defer draw
        dispatch until the scene walk is complete. VG-Lite commands are then
        encoded into a long frame stream and submitted at the display boundary.
        Software draw tasks and short-lived layer resources remain explicit,
        measured synchronization boundaries until their GPU replacements land.

config FEATHERTALK_LVGL_GPU_TRANSIENT_BYTES
    int "Per-frame GPU transient resource arena size"
    depends on FEATHERTALK_USING_LVGL_GPU_BATCH
    default 196608
    help
        GPU-visible storage retained until the current frame completes. The
        first implementation uses it for A8 glyph copies so LVGL's reusable
        font scratch buffer never forces a per-glyph GPU finish. Arena overflow
        creates a measured split and safely reuses the storage. 192 KiB is the
        largest guarded size that fits beside two 480x800 RGB565 buffers and
        the enlarged VG-Lite command/tessellation buffers in the 3 MiB GFX RAM.

config FEATHERTALK_USING_FLASH_STORAGE
    bool "Enable fixed 2 MiB internal Flash storage"
    depends on BSP_USING_FILESYSTEM
    select BSP_USING_FLASH
    default y
    help
        Reserve the final 2 MiB of the external QSPI NOR Flash
        (0x60E00000..0x61000000) as a product-owned FAT volume.  This region
        is outside the M55 XIP image and its signed trailer, so firmware
        updates that retain the board linker layout do not overwrite it.

config FEATHERTALK_USING_USB_MSC
    bool "Enable FeatherTalk USB Device Flash + SD storage"
    depends on BSP_USING_USB && BSP_USB_ROLE_DEVICE_CUSTOM
    depends on BSP_USING_SDCARD
    depends on FEATHERTALK_USING_FLASH_STORAGE
    select RT_CHERRYUSB_DEVICE_SPEED_HS
    select RT_CHERRYUSB_DEVICE_DWC2_INFINEON
    select RT_CHERRYUSB_DEVICE_MSC
    default y
    help
        Let the USB settings page transfer exclusive ownership of the internal
        Flash and SD card between local DFS and a two-LUN CherryUSB Device MSC
        function. USB Host is not supported by this board revision.

config FEATHERTALK_USING_USB_UAC
    bool "Enable FeatherTalk bidirectional USB Audio Class 2"
    depends on BSP_USING_USB && BSP_USB_ROLE_DEVICE_CUSTOM
    depends on RT_USING_AUDIO
    select RT_CHERRYUSB_DEVICE_SPEED_HS
    select RT_CHERRYUSB_DEVICE_DWC2_INFINEON
    select RT_CHERRYUSB_DEVICE_AUDIO
    default y
    help
        Expose sound0 as a host-to-device speaker and mic0 as a
        device-to-host microphone. The UAC2 clock and alternate-setting
        controls are synchronized with the product audio service and UI.

config FEATHERTALK_UI_TEST_MODE
    bool "Enable automatic FeatherTalk UI interaction test"
    depends on FEATHERTALK_USING_UI_SHELL
    default n
    help
        Start an LVGL-thread test sequencer after boot. It exercises Shell,
        Alert, notifications, Search, every current interactive control,
        Start/All Apps, preferences, business pages, route limits, and object
        release diagnostics.
        Keep this disabled in production firmware.

endmenu
```
